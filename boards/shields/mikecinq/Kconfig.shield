## boards/shields/mikecinq/Kconfig.shield
```kconfig
config SHIELD_MIKECINQ
    def_bool $(shields_list_contains,mikecinq)
config SHIELD_MIKECINQ_DONGLE
    def_bool $(shields_list_contains,mikecinq_dongle)   
```
